## config/west.yml
```yaml
manifest:
  defaults:
    revision: v0.3 #default
  remotes:
    - name: zmkfirmware
      url-base: https://github.com/zmkfirmware
    #Urchin Animation
    - name: gpeye
      url-base: https://github.com/GPeye
    #-----
    # Additional modules containing boards/shields/custom code can be listed here as well
    # See https://docs.zephyrproject.org/3.2.0/develop/west/manifest.html#projects
  projects:
    - name: zmk
      remote: zmkfirmware
      import: app/west.yml
    #Urchin Animation
    - name: urchin-peripheral-animation
      remote: gpeye
      revision: main
    #-----
  self:
    path: config
```
